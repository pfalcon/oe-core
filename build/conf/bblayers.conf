## build/conf/bblayers.conf
```bitbake
# LAYER_CONF_VERSION is increased each time build/conf/bblayers.conf
# changes incompatibly
LCONF_VERSION = "5"

BBPATH = "${TOPDIR}"
BBFILES ?= ""

BBLAYERS ?= " \
  ${TOPDIR}/../meta \
  ${TOPDIR}/../meta-oe/meta-oe \
  ${TOPDIR}/../meta-prefixdistro \
  "



BBLAYERS_NON_REMOVABLE ?= " \
  ${TOPDIR}/../meta \
  "
```
